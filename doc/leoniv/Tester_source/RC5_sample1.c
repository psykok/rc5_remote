//----------------------------------------------------------------------------

//Декодер RC-5

//----------------------------------------------------------------------------

//Декодер использует два прерывания: внешнее от фотоприемника и
//прерывание по переполнению таймера 0.
//После того, как обнаружен стартовый бит (переход из единицы
//в ноль на входе прерывания), в обработчике внешнего прерывания
//разрешается прерывание таймера 0 и загружается интервал до первой
//выборки T_SAMPLE / 2. В прерывании таймера 0 делаются выборки для
//первой и второй половинки бита. Подсчет выборок ведется в переменной SampCnt.
//По первой половине битового интервала принимается решение о значении
//принятого бита. Для проверки корректности кода Манчестер этот уровень
//сравнивается со значением второй половины предыдущего битового интервала,
//которое сохраняется в переменной PreVal. Если значения совпадают,
//значит произошла ошибка, прием начинается с начала.
//То же самое происходит, если очередной переход на входе
//не обнаружен через время T_SAMPLE после последней выборки
//(ошибка таймаута). Принятые биты вдвигаются в переменную Rc5Code.
//Подсчет принятых битов осуществляется в переменной BitCounter.
//Когда принято RC5_LENGTH битов, прием завершен, номер системы
//копируется в переменную SysVar, а код команды - в переменную ComVar.
//Декодер поддерживает Extended RC-5 Code, второй стартовый бит
//интерпретируется как бит F (Field). Бит F представляет собой
//инвертированный дополнительный (старший) бит кода команды,
//в результате количество команд удваивается.

//----------------------------------------------------------------------------

#include "Main.h"
#include "RC5.h"

//----------------------------- Константы: -----------------------------------

#define PRE            64           //предделитель таймера 0
#define RC5_SLOT     1778           //длительность слота RC-5, мкс
#define RC5_LENGTH     14           //количество принимаемых битов

#define T_SAMPLE ((char)(RC5_SLOT / 2 * F_CLK / PRE + 0.5))

//----------------------------- Переменные: ----------------------------------

static char SampCnt;                //счетчик выборок
static bool Val;                    //принятое значение бита
static bool PreVal;                 //значение педыдущего полу-интервала
static int RC5Code;                 //принятый код
static char BitCounter;             //счетчик принятых битов
static char SysVar;                 //номер системы
static char ComVar;                 //код команды

//-------------------------- Прототипы функций: ------------------------------

#pragma vector = INT0_vect
__interrupt void EdgeIR(void);      //прерывание по сигналу фотоприемника
#pragma vector = TIMER0_OVF_vect
__interrupt void TimerIR(void);     //прерывание таймера 0

//----------------- Инициализация модуля декодера RC-5: ----------------------

void RC5_Init(void)
{
  BitCounter = RC5_LENGTH;          //инициализация счетчика битов
  PreVal = 1;                       //перед стартовым битом единица
  SysVar = 0xFF;                    //неиспользуемый код системы
  ComVar = 0xFF;                    //неиспользуемый код команды
  TCCR0 = (1<<CS00) | (1<<CS01);    //прескалер CK/64 для таймера 0
  MCUCR = (1<<ISC01);               //настройка INT0 по спаду
  GIFR = (1<<INTF0);                //очистка отложенных прерываний
  GICR |= (1<<INT0);                //разрешение INT0
}

//------------- Обработчик прерывания по сигналу фотоприемника: --------------

#pragma vector = INT0_vect
__interrupt void EdgeIR(void)
{
  Port_LED_1;
  GICR &= ~(1<<INT0);               //запрещение INT0
  TCNT0 = 256 - T_SAMPLE / 2;       //интервал до первой выборки
  TIFR = (1<<TOV0);                 //очистка отложенных прерываний
  TIMSK |= (1<<TOIE0);              //разрешение прерываний таймера 0
  SampCnt = 2;                      //количесто выборок на битовом интервале
  Val = 0;                          //очистка принятого значения
}
    
//------------------ Обработчик прерывания таймера 0: ------------------------

#pragma vector = TIMER0_OVF_vect
__interrupt void TimerIR(void)
{
  if(SampCnt)                       //проверка таймаута
  {
    Val = Pin_RC5;                  //чтение состояния входа
    if(--SampCnt)                   //сделана выборка второй половины бита
    {
      TCNT0 = 256 - T_SAMPLE;       //загрузка интервала выборок
      if(Val != PreVal)             //проверка корректности кода Манчестер
      {
        RC5Code <<= 1;              //сдвиг принятого кода
        if(!Val) RC5Code |= 1;      //вторая половина = 0, бит = 1
        return;
      }
    }
    else                            //сделана выборка первой половины бита
    {
      TCNT0 = 256 - T_SAMPLE;       //загрузка интервала таймаута
      PreVal = Val;                 //сохранение первой половины бита
      if(PreVal)                    //обнаружена единица,
        MCUCR &= ~(1<<ISC00);       //INT0 по спаду,
          else MCUCR |= (1<<ISC00); //иначе INT0 по фронту
      GICR |= (1<<INT0);            //разрешение INT0
      if(--BitCounter)              //декремент счетчика битов
        return;                     //переход к следующей выборке
      SysVar = (RC5Code >> 6) & 0x3F; //номер системы
      ComVar = RC5Code & 0x3F;      //код команды
      if(!(RC5Code & 0x1000))       //добавление бита F
        ComVar |= 0x40;
    }
  }
  BitCounter = RC5_LENGTH;          //загрузка счетчика битов
  PreVal = 1;                       //перед стартовым битом единица
  TIMSK &= ~(1<<TOIE0);             //запрещение прерываний таймера 0
  MCUCR &= ~(1<<ISC00);             //INT0 по спаду
  GICR |= (1<<INT0);                //разрешение INT0
  Port_LED_0;
}

//------------------------- Чтение номера системы: ---------------------------

char RC5_GetSys(void)
{
  return(SysVar);
}

//-------------------------- Чтение кода команды: ----------------------------

char RC5_GetCom(void)
{
  return(ComVar);
}

//----------------------------------------------------------------------------
