//----------------------------------------------------------------------------

//Project:  RC-5 Tester - главный модуль
//Compiler: IAR EWAVR 4.21A
//Target:   ATmega8

//----------------------------------------------------------------------------

//Fuses:

//SPI Enable
//Int RCosc, Frequency 8MHz
//Startup: 64 ms + 6 CK,
//No BOD function

//WDTON = 1, OCDEN = 1, SPIEN = 0, EESAVE = 1,
//BOOTSZ = 00, BOOTRST = 1, CKOPT = 1,
//BODLEVEL = 1, BODEN = 1, CKSEL = 0100, SUT = 10

//----------------------------------------------------------------------------

#include "Main.h"
#include "Display.h"
#include "RC5.h"

//----------------------------- Переменные: ----------------------------------

volatile bool fTick;               //флаг обновления системного таймера
static bool tick;                  //флаг начала нового системного интервала

//-------------------------- Прототипы функций: ------------------------------

void main(void);                   //основная программа
void Main_Wdt_Init(void);          //инициализация watchdog-таймера
void Main_Rst_Wdt(bool t);         //рестарт watchdog-таймера
void Main_Ports_Init(void);        //инициализация портов
void Main_Timer_Init(void);        //инициализация системного таймера
bool Main_GetTick(void);           //опрос системного таймера
#pragma vector = TIMER1_COMPA_vect
__interrupt void Timer(void);      //прерывание системного таймера

//----------------------------------------------------------------------------
//-------------------------- Основная программа: -----------------------------
//----------------------------------------------------------------------------

void main(void)
{
  Main_Wdt_Init();                 //инициализация watchdog таймера
  Main_Ports_Init();               //инициализация портов
  Main_Timer_Init();               //инициализация системного таймера
  Display_Init();                  //инициализация дисплея
  RC5_Init();                      //инициализация модуля декодера RC-5
  __enable_interrupt();            //разрешение прерываний

  while(1)                         //основной цикл
  {
    tick = Main_GetTick();         //опрос системного таймера
    Display_Exe(tick);             //сканирование дисплея
    Display_RC5(tick);             //вывод значений
    Main_Rst_Wdt(tick);            //рестарт watchdog-таймера
  }
}

//----------------------------------------------------------------------------
//----------------------------------------------------------------------------
//----------------------------------------------------------------------------

//--------------------- Инициализация watchdog-таймера: ----------------------

void Main_Wdt_Init(void)
{
  WDTCR = (1<<WDCE) | (1<<WDE);    //разрешение watchdog-таймера,
  WDTCR = (1<<WDE) | (1<<WDP2);    //интервал 260 мс
  __watchdog_reset();
}

//------------------------ Рестарт watchdog-таймера: -------------------------

void Main_Rst_Wdt(bool t)
{
  if(t)                            //если новый системный интервал,
    __watchdog_reset();            //рестарт watchdog-таймера
}

//------------------------- Инициализация портов: ----------------------------

void Main_Ports_Init(void)
{
  DDRB  = I_DDRB;
  PORTB = I_PORTB;
  DDRC  = I_DDRC;
  PORTC = I_PORTC;
  DDRD  = I_DDRD;
  PORTD = I_PORTD;
}

//------------------ Инициализация системного таймера ------------------------

void Main_Timer_Init(void)
{
  TCCR1A = 0;
  //режим таймера 1: CTC, CK/1
  TCCR1B = (1 << WGM12) | (1 << CS10);
  OCR1A = (F_CLK * T_SYS) - 1;     //загрузка регистра сравнения
  TIFR = (1 << OCF1A);             //сброс отложенных прерываний
  TIMSK |= (1 << OCIE1A);          //разрешение прерывания по совпадению
  fTick = 1;                       //принудительное обновление
}

//--------------------- Проверка системного таймера: -------------------------

__monitor bool Main_GetTick(void)
{
  if(!fTick) return(0);            //проверка нового системного интервала
  fTick = 0;                       //очистка флага
  return(1);                       //новый системный интервал
}

//------------------- Прерывание системного таймера: -------------------------

#pragma vector = TIMER1_COMPA_vect
__interrupt void Timer(void)
{
  fTick = 1;                       //новый системный интервал
}

//----------------------------------------------------------------------------

